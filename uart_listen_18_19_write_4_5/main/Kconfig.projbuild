## uart_listen_18_19_write_4_5/main/Kconfig.projbuild
```kconfig
menu "Bridge for 2 Port UART Configuration"

    orsource "$IDF_PATH/examples/common_components/env_caps/$IDF_TARGET/Kconfig.env_caps"

    config BRIDGE_UART_PORT_NUM_0
        int "Bridge UART port number 0"
        range 0 2 if IDF_TARGET_ESP32 || IDF_TARGET_ESP32S3
        default 2 if IDF_TARGET_ESP32 || IDF_TARGET_ESP32S3
        range 0 1
        default 0
        help
            UART communication port number for the example.
            See UART documentation for available port numbers.

    config BRIDGE_UART_BAUD_RATE_0
        int "UART communication speed for port 0"
        range 1200 115200
        default 115200
        help
            UART communication speed for Bridge port 0.

    config BRIDGE_UART_RXD_PIN_0
        int "UART RXD pin number"
        range ENV_GPIO_RANGE_MIN ENV_GPIO_IN_RANGE_MAX
        default 5
        help
            GPIO number for UART RX pin. See UART documentation for more information
            about available pin numbers for UART.

    config BRIDGE_UART_TXD_PIN_0
        int "UART TXD pin number"
        range ENV_GPIO_RANGE_MIN ENV_GPIO_OUT_RANGE_MAX
        default 4
        help
            GPIO number for UART TX pin. See UART documentation for more information
            about available pin numbers for UART.

    config BRIDGE_UART_PORT_0_STACK_SIZE
        int "UART port 0 stack size"
        range 1024 16384
        default 2048
        help
            Defines stack size for UART port 0. Insufficient stack size can cause crash.

    config BRIDGE_UART_PORT_NUM_1
        int "Bridge UART port number 1"
        range 0 2 if IDF_TARGET_ESP32 || IDF_TARGET_ESP32S3
        default 2 if IDF_TARGET_ESP32 || IDF_TARGET_ESP32S3
        range 0 1
        default 1
        help
            UART communication port number for the example.
            See UART documentation for available port numbers.

    config BRIDGE_UART_BAUD_RATE_1
        int "UART communication speed for port 1"
        range 1200 115200
        default 115200
        help
            UART communication speed for Bridge port 1.

    config BRIDGE_UART_RXD_PIN_1
        int "UART RXD pin number"
        range ENV_GPIO_RANGE_MIN ENV_GPIO_IN_RANGE_MAX
        default 19
        help
            GPIO number for UART RX pin. See UART documentation for more information
            about available pin numbers for UART.

    config BRIDGE_UART_TXD_PIN_1
        int "UART TXD pin number"
        range ENV_GPIO_RANGE_MIN ENV_GPIO_OUT_RANGE_MAX
        default 18
        help
            GPIO number for UART TX pin. See UART documentation for more information
            about available pin numbers for UART.

    config BRIDGE_UART_PORT_1_STACK_SIZE
        int "UART port 1 stack size"
        range 1024 16384
        default 2048
        help
            Defines stack size for UART port 1. Insufficient stack size can cause crash.

endmenu
```
